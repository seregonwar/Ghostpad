## esp32-ghostpad/main/Kconfig.projbuild
```kconfig
menu "Ghostpad Bridge Configuration"

    config GHOSTPAD_WIFI_HOSTNAME
        string "mDNS/WiFi hostname"
        default "ghostpad"

    config GHOSTPAD_STA_SSID
        string "WiFi STA SSID (LAN client mode)"
        default ""

    config GHOSTPAD_STA_PASSWORD
        string "WiFi STA Password"
        default ""

    config GHOSTPAD_STA_MAX_RETRY
        int "STA max reconnection retries"
        default 5
        range 0 100

    config GHOSTPAD_STA_CONNECT_TIMEOUT_SEC
        int "STA connection timeout (seconds)"
        default 15
        range 1 120

    config GHOSTPAD_AP_SSID
        string "SoftAP SSID (fallback)"
        default "Ghostpad-ESP32"

    config GHOSTPAD_AP_PASSWORD
        string "SoftAP password"
        default "ghostpad123"

    config GHOSTPAD_AP_MAX_CONN
        int "SoftAP max connections"
        default 4
        range 1 10

    config GHOSTPAD_AP_CHANNEL
        int "SoftAP channel"
        default 1
        range 1 13

    config GHOSTPAD_WIFI_MODE_AP_ONLY
        bool "AP-only mode (no STA)"
        default n

    config GHOSTPAD_WIFI_MODE_STA_ONLY
        bool "STA-only mode (no AP fallback)"
        default n

    config GHOSTPAD_ENABLE_MDNS
        bool "Enable mDNS responder"
        default n

endmenu
```

## esp32-ghostpad/sdkconfig.defaults
```kconfig
CONFIG_IDF_TARGET="esp32p4"

CONFIG_ESP32P4_SELECTS_REV_LESS_V3=y
CONFIG_ESP32P4_REV_MIN_100=y

CONFIG_HTTPD_WS_SUPPORT=y

CONFIG_ESPTOOLPY_FLASHSIZE_32MB=y

CONFIG_PARTITION_TABLE_OFFSET=0x10000

# ESP hosted + remote WiFi (ESP32-C6 co-processor via SDIO)
CONFIG_ESP_HOSTED_ENABLED=y
CONFIG_ESP_HOSTED_SDIO_HOST_INTERFACE=y
CONFIG_ESP_HOSTED_IDF_SLAVE_TARGET="esp32c6"
CONFIG_ESP_HOSTED_SDIO_4_BIT_BUS=y
CONFIG_ESP_HOSTED_SDIO_BUS_WIDTH=4
CONFIG_ESP_HOSTED_SDIO_CLOCK_FREQ_KHZ=40000
CONFIG_ESP_HOSTED_SDIO_RESET_ACTIVE_HIGH=y
CONFIG_ESP_HOSTED_SDIO_GPIO_RESET_SLAVE=54
CONFIG_ESP_HOSTED_GPIO_SLAVE_RESET_SLAVE=54
CONFIG_ESP_HOSTED_SDIO_PIN_CMD=19
CONFIG_ESP_HOSTED_SDIO_PIN_CLK=18
CONFIG_ESP_HOSTED_SDIO_PIN_D0=14
CONFIG_ESP_HOSTED_SDIO_PIN_D1=15
CONFIG_ESP_HOSTED_SDIO_PIN_D2=16
CONFIG_ESP_HOSTED_SDIO_PIN_D3=17

# Remote WiFi
CONFIG_ESP_WIFI_REMOTE_ENABLED=y

# Remote WiFi performance tuning
CONFIG_WIFI_RMT_STATIC_RX_BUFFER_NUM=16
CONFIG_WIFI_RMT_DYNAMIC_RX_BUFFER_NUM=64
CONFIG_WIFI_RMT_DYNAMIC_TX_BUFFER_NUM=64
CONFIG_WIFI_RMT_AMPDU_TX_ENABLED=y
CONFIG_WIFI_RMT_TX_BA_WIN=32
CONFIG_WIFI_RMT_AMPDU_RX_ENABLED=y
CONFIG_WIFI_RMT_RX_BA_WIN=32

# TinyUSB Stack HID Configuration
CONFIG_TINYUSB_HID_COUNT=1

# ---------------------------------------------------------------------------
# NimBLE host-only BLE stack
# Controller lives on ESP32-C6; HCI frames travel over esp-hosted SDIO
# ---------------------------------------------------------------------------
CONFIG_BT_ENABLED=y
CONFIG_BT_NIMBLE_ENABLED=y

# Disable any local BT controller — P4 has none
CONFIG_BT_CONTROLLER_DISABLED=y

# Do NOT use UART as HCI transport: use esp-hosted VHCI instead
CONFIG_BT_NIMBLE_TRANSPORT_UART=n

# Bridge NimBLE HCI over the existing esp-hosted SDIO channel
CONFIG_ESP_HOSTED_ENABLE_BT_NIMBLE=y

# Only need one simultaneous connection (one gamepad)
CONFIG_BT_NIMBLE_MAX_CONNECTIONS=1

# Role: central scanner only — we connect TO the controller
CONFIG_BT_NIMBLE_ROLE_CENTRAL=y
CONFIG_BT_NIMBLE_ROLE_PERIPHERAL=n
CONFIG_BT_NIMBLE_ROLE_BROADCASTER=n
CONFIG_BT_NIMBLE_ROLE_OBSERVER=y

# Increase GATT client table for HID service discovery
CONFIG_BT_NIMBLE_GATT_MAX_PROCS=8

# Stack size for NimBLE host task
CONFIG_BT_NIMBLE_HOST_TASK_STACK_SIZE=5120

# ---------------------------------------------------------------------------
# Ghostpad Bridge Configuration
# ---------------------------------------------------------------------------
CONFIG_GHOSTPAD_WIFI_HOSTNAME="ghostpad"
CONFIG_GHOSTPAD_STA_SSID=""
CONFIG_GHOSTPAD_STA_PASSWORD=""
CONFIG_GHOSTPAD_STA_MAX_RETRY=5
CONFIG_GHOSTPAD_STA_CONNECT_TIMEOUT_SEC=15
CONFIG_GHOSTPAD_AP_SSID="Ghostpad-ESP32"
CONFIG_GHOSTPAD_AP_PASSWORD="ghostpad123"
CONFIG_GHOSTPAD_AP_MAX_CONN=4
CONFIG_GHOSTPAD_AP_CHANNEL=1
CONFIG_GHOSTPAD_ENABLE_MDNS=y
```

## esp32-ghostpad/sdkconfig.defaults.esp32
```kconfig
CONFIG_IDF_TARGET="esp32"

CONFIG_HTTPD_WS_SUPPORT=y

CONFIG_ESPTOOLPY_FLASHSIZE_4MB=y

CONFIG_PARTITION_TABLE_CUSTOM=y
CONFIG_PARTITION_TABLE_CUSTOM_FILENAME="partitions_esp32.csv"
CONFIG_PARTITION_TABLE_OFFSET=0x8000

# ---------------------------------------------------------------------------
# WiFi
# ---------------------------------------------------------------------------
CONFIG_ESP_WIFI_ENABLED=y
CONFIG_ESP_WIFI_STATIC_RX_BUFFER_NUM=10
CONFIG_ESP_WIFI_DYNAMIC_RX_BUFFER_NUM=32
CONFIG_ESP_WIFI_DYNAMIC_TX_BUFFER_NUM=32

# ---------------------------------------------------------------------------
# ---------------------------------------------------------------------------
# Bluepad32 BTstack configuration
# ---------------------------------------------------------------------------
CONFIG_BT_ENABLED=y
CONFIG_BT_CONTROLLER_ONLY=y
CONFIG_BTDM_CTRL_MODE_BTDM=y
CONFIG_BT_BLUEDROID_ENABLED=n
CONFIG_BT_NIMBLE_ENABLED=n

# Max connections for controller
CONFIG_BTDM_CTRL_BR_EDR_MAX_ACL_CONN_EFF=7
CONFIG_BTDM_CTRL_BLE_MAX_CONN_EFF=3
CONFIG_BTDM_CTRL_BR_EDR_MAX_ACL_CONN=7
CONFIG_BTDM_CTRL_BLE_MAX_CONN=3

# Bluepad32 platform configuration
CONFIG_BLUEPAD32_PLATFORM_CUSTOM=y
CONFIG_BLUEPAD32_PLATFORM_UNIJOYSTICLE=n
CONFIG_BLUEPAD32_MAX_DEVICES=4
CONFIG_BLUEPAD32_GAP_SECURITY=y
CONFIG_BLUEPAD32_LOG_LEVEL_INFO=y
CONFIG_BLUEPAD32_USB_CONSOLE_ENABLE=y
CONFIG_BLUEPAD32_ENABLE_BLE_BY_DEFAULT=y

# ---------------------------------------------------------------------------
# Ghostpad Bridge Configuration
# ---------------------------------------------------------------------------
CONFIG_GHOSTPAD_WIFI_HOSTNAME="ghostpad"
CONFIG_GHOSTPAD_STA_SSID=""
CONFIG_GHOSTPAD_STA_PASSWORD=""
CONFIG_GHOSTPAD_STA_MAX_RETRY=5
CONFIG_GHOSTPAD_STA_CONNECT_TIMEOUT_SEC=15
CONFIG_GHOSTPAD_AP_SSID="Ghostpad-ESP32"
CONFIG_GHOSTPAD_AP_PASSWORD="ghostpad123"
CONFIG_GHOSTPAD_AP_MAX_CONN=4
CONFIG_GHOSTPAD_AP_CHANNEL=1
CONFIG_GHOSTPAD_ENABLE_MDNS=y

# ---------------------------------------------------------------------------
# Compiler Optimization (Release/Size)
# ---------------------------------------------------------------------------
CONFIG_COMPILER_OPTIMIZATION_SIZE=y
CONFIG_COMPILER_OPTIMIZATION_DEBUG=n

# ---------------------------------------------------------------------------
# Memory Optimizations (Reduce IRAM usage)
# ---------------------------------------------------------------------------
CONFIG_ESP_PHY_IRAM_OPT=n
CONFIG_ESP_WIFI_IRAM_OPT=n
CONFIG_ESP_WIFI_RX_IRAM_OPT=n
CONFIG_ESP32_WIFI_IRAM_OPT=n
CONFIG_ESP32_WIFI_RX_IRAM_OPT=n
```
